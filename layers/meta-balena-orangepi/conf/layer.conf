## layers/meta-balena-orangepi/conf/layer.conf
```bitbake
BBPATH .= ":${LAYERDIR}"

BBFILES += "${LAYERDIR}/recipes-*/*/*.bb \
            ${LAYERDIR}/recipes-*/*/*.bbappend"

BBFILE_COLLECTIONS += "balena-orangepi"
BBFILE_PATTERN_balena-orangepi := "^${LAYERDIR}/"
BBFILE_PRIORITY_balena-orangepi = "1337"

LAYERSERIES_COMPAT_balena-orangepi = "dunfell"
```
